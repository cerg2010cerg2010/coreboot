## src/mainboard/chuwi/Kconfig
```kconfig
if VENDOR_CHUWI

choice
	prompt "Mainboard model"

source "src/mainboard/chuwi/*/Kconfig.name"

endchoice

source "src/mainboard/chuwi/*/Kconfig"

config MAINBOARD_VENDOR
	string
	default "CHUWI Innovation And Technology(ShenZhen)co.,Ltd"

endif # VENDOR_CHUWI
```

## src/mainboard/chuwi/minibook/Kconfig
```kconfig
if BOARD_CHUWI_MINIBOOK

config BOARD_SPECIFIC_OPTIONS
	def_bool y
	select SYSTEM_TYPE_CONVERTIBLE
	select BOARD_ROMSIZE_KB_8192
	select SUPERIO_ITE_IT8987E
	select SOC_INTEL_KABYLAKE
	select SOC_INTEL_COMMON_BLOCK_HDA_VERB
	select INTEL_GMA_HAVE_VBT
	select MAINBOARD_HAS_LIBGFXINIT
	select GFX_GMA_INTERNAL_IS_EDP
	select GENERIC_SPD_BIN
	select HAVE_ACPI_RESUME
	select HAVE_ACPI_TABLES
	select ADD_FSP_BINARIES
	select FSP_USE_REPO

config SPI_FLASH_INCLUDE_ALL_DRIVERS
	bool
	default n

config SPI_FLASH
	bool
	default y

config SPI_FLASH_WINBOND
	bool
	default y

config DIMM_SPD_SIZE
	int
	default 512

config VGA_BIOS_ID
	string
	default "8086,591c"

config IRQ_SLOT_COUNT
	int
	default 18

config MINIBOOK_EC_BIN_PATH
	string
	default "3rdparty/blobs/mainboard/$(CONFIG_MAINBOARD_DIR)/ec.bin"

config FSP_FD_PATH
	string
	#default "3rdparty/fsp/AmberLakeFspBinPkg/Fsp.fd"
	default "3rdparty/fsp/KabylakeFspBinPkg/Fsp.fd"

config FSP_HEADER_PATH
	string
	#default "3rdparty/fsp/AmberLakeFspBinPkg/Include/"
	default "3rdparty/fsp/KabylakeFspBinPkg/Include/"

config MAX_CPUS
	int
	default 4

config CBFS_SIZE
	hex
	default 0x600000

config MAINBOARD_DIR
	string
	default "chuwi/minibook"

config MAINBOARD_PART_NUMBER
	string
	default "MiniBook"

endif
```

## src/superio/ite/it8987e/Kconfig
```kconfig
##
## This file is part of the coreboot project.
##
## Copyright (C) 2019 Sergey Larin <cerg2010cerg2010@mail.ru>
##
## This program is free software; you can redistribute it and/or modify
## it under the terms of the GNU General Public License as published by
## the Free Software Foundation; version 2 of the License.
##
## This program is distributed in the hope that it will be useful,
## but WITHOUT ANY WARRANTY; without even the implied warranty of
## MERCHANTABILITY or FITNESS FOR A PARTICULAR PURPOSE.  See the
## GNU General Public License for more details.
##

config SUPERIO_ITE_IT8987E
	bool
	select SUPERIO_ITE_COMMON_PRE_RAM
```
